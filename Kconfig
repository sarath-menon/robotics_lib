## Kconfig
```kconfig
#shorter path name
LIB_PATH=$(ZEPHYR_ROBOTICS_LIB_MODULE_DIR)

menuconfig ENABLE_ROBOTICS_LIB
	bool "Include robotics_lib"
    default n
	help
	  Enables robotics_lib libraty that provies several utilities for robotics

if ENABLE_ROBOTICS_LIB
	source "$(LIB_PATH)/rl_src/communication/Kconfig"
	source "$(LIB_PATH)/rl_src/drivers/Kconfig"
	source "$(LIB_PATH)/rl_src/testing/Kconfig"
endif # ENABLE_ROBOTICS_LIB
```

## rl_src/drivers/Kconfig
```kconfig
menuconfig RL_DRIVERS
	bool "enable drivers"
    default y
	help
	  Enables drivers from robotics_lib

if(RL_DRIVERS)

source "$(LIB_PATH)/rl_src/drivers/sensors/Kconfig"
source "$(LIB_PATH)/rl_src/drivers/actuators/Kconfig"
source "$(LIB_PATH)/rl_src/drivers/io_devices/Kconfig"

endif 
```

## rl_src/drivers/actuators/Kconfig
```kconfig
menuconfig RL_ACTUATORS
	bool "enable actuator drivers"
    default y
	help
	  Enables actuator drivers from robotics_lib

if RL_ACTUATORS
	source "$(LIB_PATH)/rl_src/drivers/actuators/motors/Kconfig"
endif 
```

## rl_src/drivers/actuators/motors/Kconfig
```kconfig
menuconfig RL_ACTUATORS_MOTORS
	bool "enable coreless motor driver"
    default y
	help
	  Enables coreless motor driver from robotics_lib

if RL_ACTUATORS_MOTORS
	source "$(LIB_PATH)/rl_src/drivers/actuators/motors/coreless_motor/Kconfig"
endif # RL_SENSORS
```

## rl_src/drivers/interfaces/peripherals/Kconfig
```kconfig
menuconfig RL_PERIPHERAL_INTERFACES
	bool "enable peripheral interface drivers"
    default y
	help
	  Enables peripheral interface drivers from robotics_lib

if RL_PERIPHERAL_INTERFACES
	source "$(LIB_PATH)/rl_src/drivers/sensors/imu/Kconfig"
endif # RL_SENSORS
```

## rl_src/drivers/io_devices/led/Kconfig
```kconfig
config RL_IO_DEVICES_LED
	bool "enable led i/o driver"
    default y
	help
	  Enables led i/o driver from robotics_lib
```

## rl_src/drivers/sensors/imu/Kconfig
```kconfig
menuconfig RL_SENSORS_IMU
	bool "enable imu sensor driver"
    default y
	help
	  Enables imu sensor drivers from robotics_lib

if RL_SENSORS_IMU
	source "$(LIB_PATH)/rl_src/drivers/sensors/imu/bmi088/Kconfig"
endif # RL_SENSORS
```

## rl_src/drivers/sensors/imu/bmi088/Kconfig
```kconfig
config RL_SENSORS_IMU_BMI088
	bool "enable bmi088 imu driver"
    default y
	help
	  Enables bmi088 imu driver from robotics_lib
```

## src/communication/Kconfig
```kconfig
menuconfig RL_COMMUNICATION
	bool "enable communication utilities"
    default y
	help
	  Enables communication utilities from robotics_lib

if(RL_COMMUNICATION)

source "$(LIB_PATH)/src/communication/uart_dma/Kconfig"
source "$(LIB_PATH)/src/communication/usb_console/Kconfig"

endif #RL_COMMUNICATION
```

## src/communication/uart_dma/Kconfig
```kconfig
menuconfig RL_COMMUNICATION_UART_DMA
	bool "enable UART dma driver"
    default y
	help
	  Enables UART dma driver from robotics_lib
```

## src/communication/usb_console/Kconfig
```kconfig
menuconfig RL_COMMUNICATION_USB_CONSOLE
	bool "enable USB console communication driver"
    default y
	help
	  Enables communication drivers from robotics_lib
```

## src/drivers/Kconfig
```kconfig
source "$(LIB_PATH)/src/drivers/sensors/Kconfig"
# source "$(LIB_PATH)/src/drivers/actuators/Kconfig"
source "$(LIB_PATH)/src/drivers/io_devices/Kconfig"
```

## src/drivers/actuators/Kconfig
```kconfig
menuconfig RL_ACTUATORS
	bool "enable actuator drivers"
    default y
	help
	  Enables actuator drivers from robotics_lib

if RL_ACTUATORS
	source "$(LIB_PATH)/src/drivers/actuators/motors/Kconfig"
endif 
```

## src/drivers/actuators/motors/Kconfig
```kconfig
menuconfig RL_ACTUATORS_MOTORS
	bool "enable coreless motor driver"
    default y
	help
	  Enables coreless motor driver from robotics_lib

if RL_ACTUATORS_MOTORS
	source "$(LIB_PATH)/src/drivers/actuators/motors/coreless_motor/Kconfig"
endif # RL_SENSORS
```

## src/drivers/actuators/motors/coreless_motor/Kconfig
```kconfig
config RL_ACTUATORS_MOTOR_CORELESS
	bool "enable coreless motor driver"
    default y
	help
	  Enables bmi088 imu driver from robotics_lib
```

## src/drivers/interfaces/Kconfig
```kconfig
menuconfig RL_INTERFACES
	bool "enable interface drivers"
    default y
	help
	  Enables actuator drivers from robotics_lib

if RL_INTERFACES
	source "$(LIB_PATH)/src/drivers/sensors/imu/Kconfig"
endif # RL_SENSORS
```

## src/drivers/io_devices/Kconfig
```kconfig
menuconfig RL_IO_DEVICES
	bool "enable i/o device drivers"
    default y
	help
	  Enables i/o device drivers from robotics_lib

if RL_IO_DEVICES
	source "$(LIB_PATH)/src/drivers/io_devices/button/Kconfig"
	source "$(LIB_PATH)/src/drivers/io_devices/led/Kconfig"
endif # RL_SENSORS
```

## src/drivers/io_devices/button/Kconfig
```kconfig
config RL_IO_DEVICES_BUTTON
	bool "enable button i/o driver"
    default y
	help
	  Enables button i/o driver from robotics_lib
```

## src/drivers/sensors/Kconfig
```kconfig
menuconfig RL_SENSORS
	bool "enable sensor drivers"
    default y
	help
	  Enables sensor drivers from robotics_lib

if RL_SENSORS
	source "$(LIB_PATH)/src/drivers/sensors/imu/Kconfig"
endif # RL_SENSORS
```

## src/drivers/sensors/imu/bmi088/Kconfig
```kconfig
config RL_SENSORS_IMU_BMI088
	bool "enable bmi088 imu driver"
    default y
	help
	  Enables bmi088 imu driver from robotics_lib


# if RL_SENSORS_IMU_BMI088

# choice
# 	prompt "select BMI088 communication interface"
# 	default BMI088_I2C
# 	help
# 	  BMI088 communication interface

# config BMI088_I2C
# 	bool "i2c"
# 	help
# 	  enable i2c interface for bmi088

# config BMI088_SPI
# 	bool "spi"
# 	help
# 	  enable spi interface for bmi088

# endchoice

# endif #RL_SENSORS
```

## src/testing/Kconfig
```kconfig
menuconfig RL_TESTING
	bool "enables unit testing"
    default y
	help
	  Enables communication drivers from robotics_lib
```

## zephyr/Kconfig
```kconfig
config HELLO_WORLD_DRIVER
	bool "Support for the demonstration out of tree driver"
    default n
	help
	  Enables hello world driver
```
